## app/modules/cortex-m_atomics/Kconfig
```kconfig
menuconfig CORTEX_M_ATOMIC_POLYFILL
	bool "Cortex M0/M0+ Atomic polyfill"
    depends on STD_CPP20
    help
      Support for atomic operations for cortex m0 and cortex m0+
```

## app/modules/ditto/Kconfig
```kconfig
menuconfig DITTO
	bool "Ditto library"
    depends on STD_CPP20
    help
      Add Ditto support to your zephyr application
```

## app/modules/postform/Kconfig
```kconfig
menuconfig POSTFORM
	bool "Postform library"
    depends on STD_CPP20 && DITTO
    help
      Add Postform support to your zephyr application
```
