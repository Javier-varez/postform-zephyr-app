## CMakeLists.txt
```
cmake_minimum_required(VERSION 3.13.1)

find_package(Zephyr REQUIRED HINTS $ENV{ZEPHYR_BASE})

project(app LANGUAGES C CXX VERSION 1.0.0)

target_sources(app PRIVATE
    src/main.cpp
    src/postform_config.cpp)
```

## west.yml
```
manifest:
  remotes:
    - name: zephyrproject-rtos
      url-base: https://github.com/zephyrproject-rtos
    - name: javier-varez
      url-base: https://github.com/javier-varez

  projects:
    - name: zephyr
      remote: zephyrproject-rtos
      revision: v3.3.0
      import: true
    - name: postform
      remote: javier-varez
      revision: feat/zephyr-module
      path: modules/lib/postform
    - name: ditto
      remote: javier-varez
      revision: feat/zephyr-module
      path: modules/lib/ditto
    - name: cortex-m_atomics
      remote: javier-varez
      revision: feat/zephyr-module
      path: modules/lib/cortex-m_atomics
```

## prj.conf
```kconfig
CONFIG_CPP=y
CONFIG_STD_CPP20=y
CONFIG_GLIBCXX_LIBCPP=y
CONFIG_CPP_MAIN=y
CONFIG_NEWLIB_LIBC=y
CONFIG_DITTO=y
CONFIG_POSTFORM=y
CONFIG_CORTEX_M_ATOMIC_POLYFILL=y
```

## src/main.cpp
```c
#include <zephyr/kernel.h>

#include <array>
#include <span>

#include "postform/logger.h"
#include "postform/rtt/rtt.h"
#include "postform/rtt/transport.h"
#include "postform/serial_logger.h"

constexpr static size_t RTT_CHANNEL_SIZE = 1024u;
static std::array<uint8_t, RTT_CHANNEL_SIZE> rtt_buffer;

[[gnu::used]] Postform::Rtt::ControlBlock<1u, 0u> _SEGGER_RTT{
    std::array<Postform::Rtt::ChannelDescriptor, 1u>{
        Postform::Rtt::ChannelDescriptor{
            .name = "postform_channel",
            .buffer{rtt_buffer},
        },
    },
    {},
};

static Postform::Rtt::Transport transport{&_SEGGER_RTT.up_channels[0u]};
Postform::SerialLogger<Postform::Rtt::Transport> logger{&transport};

namespace Ditto {

void assert_failed(const char* condition, int line, const char* file) {
  LOG_ERROR(&logger,
            "ASSERT FAILED! "
            "Condition `%s` failed in file `%s`, line %d",
            condition, file, line);
  while (true) {
    // Remember that infinite loops without side-effects are UB! (and normally
    // are plainly removed...)
    volatile int a = 0;
    static_cast<void>(a);
  }
}

}  // namespace Ditto
int main() {
  uint32_t count{};

  while (true) {
    LOG_ERROR(&logger, "Count is %u", count++);
    k_sleep(K_SECONDS(1));
  }
  return 0;
}
```

## src/postform_config.cpp
```c
#include <zephyr/sys_clock.h>

#include "postform/config.h"

namespace Postform {
uint64_t getGlobalTimestamp() { return sys_clock_tick_get(); }
}  // namespace Postform

DECLARE_POSTFORM_CONFIG(.timestamp_frequency = CONFIG_SYS_CLOCK_TICKS_PER_SEC);
```
